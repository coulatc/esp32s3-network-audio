## main/Kconfig.projbuild
```kconfig
menu "S3 Audio"
    config S3_AUDIO_DIAGNOSTICS
        bool "Collect USB and AirPlay playback diagnostics"
        default n
        help
            Measure USB queue latency and record AirPlay playback statistics
            for troubleshooting.
endmenu
```

## sdkconfig.defaults
```kconfig
CONFIG_ESPTOOLPY_FLASHSIZE_16MB=y
CONFIG_PARTITION_TABLE_CUSTOM=y
CONFIG_PARTITION_TABLE_CUSTOM_FILENAME="partitions.csv"
CONFIG_ESP_DEFAULT_CPU_FREQ_MHZ_240=y
CONFIG_ESP_CONSOLE_NONE=y
CONFIG_ESP_CONSOLE_SECONDARY_NONE=y
CONFIG_BOOTLOADER_LOG_LEVEL_NONE=y
CONFIG_LOG_DEFAULT_LEVEL_NONE=y
CONFIG_LOG_MAXIMUM_EQUALS_DEFAULT=y
CONFIG_LOG_TAG_LEVEL_IMPL_NONE=y
CONFIG_LOG_DYNAMIC_LEVEL_CONTROL=n
CONFIG_ESP_SYSTEM_PANIC_SILENT_REBOOT=y
CONFIG_SPIRAM=y
CONFIG_SPIRAM_MODE_OCT=y
CONFIG_SPIRAM_SPEED_80M=y
CONFIG_SPIRAM_IGNORE_NOTFOUND=y
CONFIG_SPIRAM_MALLOC_ALWAYSINTERNAL=1024
CONFIG_SPIRAM_MALLOC_RESERVE_INTERNAL=32768
CONFIG_FREERTOS_HZ=1000
CONFIG_FREERTOS_GENERATE_RUN_TIME_STATS=n
CONFIG_FREERTOS_INTERRUPT_BACKTRACE=n
CONFIG_LWIP_MAX_SOCKETS=28
CONFIG_LWIP_UDP_RECVMBOX_SIZE=64
CONFIG_LWIP_SO_RCVBUF=y
CONFIG_LWIP_TCP_WND_DEFAULT=32768
CONFIG_LWIP_TCP_RECVMBOX_SIZE=32
CONFIG_USB_HOST_CONTROL_TRANSFER_MAX_SIZE=1024
CONFIG_USB_HOST_HW_BUFFER_BIAS_PERIODIC_OUT=y
CONFIG_UAC2_STOP_STREAMS_ON_RESTART=y
CONFIG_MDNS_TASK_PRIORITY=5
CONFIG_MBEDTLS_HARDWARE_AES=y
CONFIG_MDNS_ENABLE_CONSOLE_CLI=n
CONFIG_COMPILER_OPTIMIZATION_PERF=y

CONFIG_LIBSODIUM_USE_MBEDTLS_SHA=n
```
